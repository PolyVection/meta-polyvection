## conf/distro/polyos.conf
```bitbake
# i.MX DISTRO for X11 with no wayland

include conf/distro/include/polyos-base.inc
include conf/distro/include/polyos-preferred-env.inc

DISTRO = "polyos"

# Remove conflicting backends.
DISTRO_FEATURES_remove = "wayland"

# These are X11 specific
# DISTRO_FEATURES_append = " x11"
```

## conf/machine/coreamp1.conf
```bitbake
#@TYPE: Machine
#@NAME: PolyVection CoreAMP1
#@SOC: i.MX6UL
#@DESCRIPTION: Machine configuration for PolyVection CoreAMP1
#@MAINTAINER: Philip Voigt <info@polyvection.com>

include conf/machine/include/imx-base.inc
include conf/machine/include/tune-cortexa7.inc
include conf/machine/include/imx6ul-common.inc

SOC_FAMILY = "mx6ul"

KERNEL_DEVICETREE = "imx6ul-coreamp1.dtb"

UBOOT_CONFIG ??= "sd"
UBOOT_CONFIG[sd] = "coreamp1_config,sdcard"
UBOOT_CONFIG[qspi1] = "mx6ul_14x14_evk_qspi1_config"
UBOOT_CONFIG[mfgtool] = "mx6ul_14x14_evk_config"
```

## conf/machine/polydsp1.conf
```bitbake
#@TYPE: Machine
#@NAME: PolyVection PolyDSP1
#@SOC: i.MX6ULL
#@DESCRIPTION: Machine configuration for PolyVection PolyDSP1
#@MAINTAINER: Philip Voigt <info@polyvection.com>

include conf/machine/include/imx-base-pv.inc
include conf/machine/include/tune-cortexa7.inc
include conf/machine/include/imx6ul-common.inc

MACHINE_FIRMWARE_append = " firmware-imx-epdc firmware-imx-brcm"

SOC_FAMILY = "mx6ul:mx6ull"

KERNEL_DEVICETREE = "imx6ull-polydsp1.dtb"

UBOOT_CONFIG ??= "sd"
UBOOT_CONFIG[sd] = "polydsp1_config,sdcard"
UBOOT_CONFIG[qspi1] = "mx6ul_14x14_evk_qspi1_config"
UBOOT_CONFIG[mfgtool] = "mx6ul_14x14_evk_config"
```
